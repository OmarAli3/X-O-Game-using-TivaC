// XO Game.c
// Runs on LM4F120/TM4C123


// June 1, 2020
/* This example accompanies the books
   "Embedded Systems: Real Time Interfacing to Arm Cortex M Microcontrollers",
   ISBN: 978-1463590154, Jonathan Valvano, copyright (c) 2013

   "Embedded Systems: Introduction to Arm Cortex M Microcontrollers",
   ISBN: 978-1469998749, Jonathan Valvano, copyright (c) 2013

 Copyright 2014 by Jonathan W. Valvano, valvano@mail.utexas.edu
    You may use, edit, run or distribute this file
    as long as the above copyright notice remains
 THIS SOFTWARE IS PROVIDED "AS IS".  NO WARRANTIES, WHETHER EXPRESS, IMPLIED
 OR STATUTORY, INCLUDING, BUT NOT LIMITED TO, IMPLIED WARRANTIES OF
 MERCHANTABILITY AND FITNESS FOR A PARTICULAR PURPOSE APPLY TO THIS SOFTWARE.
 VALVANO SHALL NOT, IN ANY CIRCUMSTANCES, BE LIABLE FOR SPECIAL, INCIDENTAL,
 OR CONSEQUENTIAL DAMAGES, FOR ANY REASON WHATSOEVER.
 For more information about my classes, my research, and my books, see
 http://users.ece.utexas.edu/~valvano/
 */
// ******* Required Hardware I/O connections*******************
// Slide pot pin 1 connected to ground
// Slide pot pin 2 connected to PE2/AIN1
// Slide pot pin 3 connected to +3.3V
// fire button connected to PE0
// special weapon fire button connected to PE1
// 8*R resistor DAC bit 0 on PB0 (least significant bit)
// 4*R resistor DAC bit 1 on PB1
// 2*R resistor DAC bit 2 on PB2
// 1*R resistor DAC bit 3 on PB3 (most significant bit)
// LED on PB4
// LED on PB5

// Blue Nokia 5110
// ---------------
// Signal        (Nokia 5110) LaunchPad pin
// Reset         (RST, pin 1) connected to PA7
// SSI0Fss       (CE,  pin 2) connected to PA3
// Data/Command  (DC,  pin 3) connected to PA6
// SSI0Tx        (Din, pin 4) connected to PA5
// SSI0Clk       (Clk, pin 5) connected to PA2
// 3.3V          (Vcc, pin 6) power
// back light    (BL,  pin 7) not connected, consists of 4 white LEDs which draw ~80mA total
// Ground        (Gnd, pin 8) ground

// Red SparkFun Nokia 5110 (LCD-10168)
// -----------------------------------
// Signal        (Nokia 5110) LaunchPad pin
// 3.3V          (VCC, pin 1) power
// Ground        (GND, pin 2) ground
// SSI0Fss       (SCE, pin 3) connected to PA3
// Reset         (RST, pin 4) connected to PA7
// Data/Command  (D/C, pin 5) connected to PA6
// SSI0Tx        (DN,  pin 6) connected to PA5
// SSI0Clk       (SCLK, pin 7) connected to PA2
// back light    (LED, pin 8) not connected, consists of 4 white LEDs which draw ~80mA total

#include "tm4c123gh6pm.h"
#include "Nokia5110.h"
#include "TExaS.h"

void Timer2_Init(unsigned long period);
void PortF_Init(void);
void Delay100ms(unsigned long count); // time delay in 0.1 seconds
void Intro(void); //an intro to the game
void resetGameSettings(void);
void play(void);
int  checkWinner(char player);
void displayWinner(char player);
void displayDraw(void);
void displayStatus(void);
int checkReplay(void);
void outro(void);
void ClearGameMatrix(void);
unsigned long TimerCount;
unsigned long Semaphore;


// *************************** Images ***************************

//An empty square 14px height * 14px width
const unsigned char square[] ={
 0x42, 0x4D, 0xE6, 0x00, 0x00, 0x00, 0x00, 0x00, 0x00, 0x00, 0x76, 0x00, 0x00, 0x00, 0x28, 0x00, 0x00, 0x00, 0x0E, 0x00, 0x00, 0x00, 0x0E, 0x00, 0x00, 0x00, 0x01, 0x00, 0x04, 0x00, 0x00, 0x00,
 0x00, 0x00, 0x70, 0x00, 0x00, 0x00, 0xC4, 0x0E, 0x00, 0x00, 0xC4, 0x0E, 0x00, 0x00, 0x00, 0x00, 0x00, 0x00, 0x00, 0x00, 0x00, 0x00, 0x00, 0x00, 0x00, 0x00, 0x00, 0x00, 0x80, 0x00, 0x00, 0x80,
 0x00, 0x00, 0x00, 0x80, 0x80, 0x00, 0x80, 0x00, 0x00, 0x00, 0x80, 0x00, 0x80, 0x00, 0x80, 0x80, 0x00, 0x00, 0x80, 0x80, 0x80, 0x00, 0xC0, 0xC0, 0xC0, 0x00, 0x00, 0x00, 0xFF, 0x00, 0x00, 0xFF,
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 0xFF, 0xFF, 0xFF, 0xFF, 0xFF, 0x00, 0xFF,

};

//A square with X mark 14px height * 14px width
const unsigned char X[] ={
 0x42, 0x4D, 0xE6, 0x00, 0x00, 0x00, 0x00, 0x00, 0x00, 0x00, 0x76, 0x00, 0x00, 0x00, 0x28, 0x00, 0x00, 0x00, 0x0E, 0x00, 0x00, 0x00, 0x0E, 0x00, 0x00, 0x00, 0x01, 0x00, 0x04, 0x00, 0x00, 0x00,
 0x00, 0x00, 0x70, 0x00, 0x00, 0x00, 0xC4, 0x0E, 0x00, 0x00, 0xC4, 0x0E, 0x00, 0x00, 0x00, 0x00, 0x00, 0x00, 0x00, 0x00, 0x00, 0x00, 0x00, 0x00, 0x00, 0x00, 0x00, 0x00, 0x80, 0x00, 0x00, 0x80,
 0x00, 0x00, 0x00, 0x80, 0x80, 0x00, 0x80, 0x00, 0x00, 0x00, 0x80, 0x00, 0x80, 0x00, 0x80, 0x80, 0x00, 0x00, 0x80, 0x80, 0x80, 0x00, 0xC0, 0xC0, 0xC0, 0x00, 0x00, 0x00, 0xFF, 0x00, 0x00, 0xFF,
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 0xFF, 0xFF, 0xFF, 0xFF, 0xFF, 0x00, 0xFF,

};

//A square with O mark 14px height * 14px width
const unsigned char O[] ={
 0x42, 0x4D, 0xE6, 0x00, 0x00, 0x00, 0x00, 0x00, 0x00, 0x00, 0x76, 0x00, 0x00, 0x00, 0x28, 0x00, 0x00, 0x00, 0x0E, 0x00, 0x00, 0x00, 0x0E, 0x00, 0x00, 0x00, 0x01, 0x00, 0x04, 0x00, 0x00, 0x00,
 0x00, 0x00, 0x70, 0x00, 0x00, 0x00, 0xC4, 0x0E, 0x00, 0x00, 0xC4, 0x0E, 0x00, 0x00, 0x00, 0x00, 0x00, 0x00, 0x00, 0x00, 0x00, 0x00, 0x00, 0x00, 0x00, 0x00, 0x00, 0x00, 0x80, 0x00, 0x00, 0x80,
 0x00, 0x00, 0x00, 0x80, 0x80, 0x00, 0x80, 0x00, 0x00, 0x00, 0x80, 0x00, 0x80, 0x00, 0x80, 0x80, 0x00, 0x00, 0x80, 0x80, 0x80, 0x00, 0xC0, 0xC0, 0xC0, 0x00, 0x00, 0x00, 0xFF, 0x00, 0x00, 0xFF,
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 0xFF, 0xFF, 0xFF, 0xFF, 0xFF, 0x00, 0xFF,

};

//An empty selected square 14px height * 14px width
const unsigned char selectedSquare[] ={
 0x42, 0x4D, 0xE6, 0x00, 0x00, 0x00, 0x00, 0x00, 0x00, 0x00, 0x76, 0x00, 0x00, 0x00, 0x28, 0x00, 0x00, 0x00, 0x0E, 0x00, 0x00, 0x00, 0x0E, 0x00, 0x00, 0x00, 0x01, 0x00, 0x04, 0x00, 0x00, 0x00,
 0x00, 0x00, 0x70, 0x00, 0x00, 0x00, 0xC4, 0x0E, 0x00, 0x00, 0xC4, 0x0E, 0x00, 0x00, 0x00, 0x00, 0x00, 0x00, 0x00, 0x00, 0x00, 0x00, 0x00, 0x00, 0x00, 0x00, 0x00, 0x00, 0x80, 0x00, 0x00, 0x80,
 0x00, 0x00, 0x00, 0x80, 0x80, 0x00, 0x80, 0x00, 0x00, 0x00, 0x80, 0x00, 0x80, 0x00, 0x80, 0x80, 0x00, 0x00, 0x80, 0x80, 0x80, 0x00, 0xC0, 0xC0, 0xC0, 0x00, 0x00, 0x00, 0xFF, 0x00, 0x00, 0xFF,
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 0x00, 0x00, 0x00, 0x00, 0x00, 0x00, 0xFF,

};

//A square with X mark 14px height * 14px width
const unsigned char selectedX[] ={
 0x42, 0x4D, 0xE6, 0x00, 0x00, 0x00, 0x00, 0x00, 0x00, 0x00, 0x76, 0x00, 0x00, 0x00, 0x28, 0x00, 0x00, 0x00, 0x0E, 0x00, 0x00, 0x00, 0x0E, 0x00, 0x00, 0x00, 0x01, 0x00, 0x04, 0x00, 0x00, 0x00,
 0x00, 0x00, 0x70, 0x00, 0x00, 0x00, 0xC4, 0x0E, 0x00, 0x00, 0xC4, 0x0E, 0x00, 0x00, 0x00, 0x00, 0x00, 0x00, 0x00, 0x00, 0x00, 0x00, 0x00, 0x00, 0x00, 0x00, 0x00, 0x00, 0x80, 0x00, 0x00, 0x80,
 0x00, 0x00, 0x00, 0x80, 0x80, 0x00, 0x80, 0x00, 0x00, 0x00, 0x80, 0x00, 0x80, 0x00, 0x80, 0x80, 0x00, 0x00, 0x80, 0x80, 0x80, 0x00, 0xC0, 0xC0, 0xC0, 0x00, 0x00, 0x00, 0xFF, 0x00, 0x00, 0xFF,
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 0x00, 0x00, 0x00, 0x00, 0x00, 0x00, 0xFF,

};

//A square with O mark 14px height * 14px width
const unsigned char selectedO[] ={
 0x42, 0x4D, 0xE6, 0x00, 0x00, 0x00, 0x00, 0x00, 0x00, 0x00, 0x76, 0x00, 0x00, 0x00, 0x28, 0x00, 0x00, 0x00, 0x0E, 0x00, 0x00, 0x00, 0x0E, 0x00, 0x00, 0x00, 0x01, 0x00, 0x04, 0x00, 0x00, 0x00,
 0x00, 0x00, 0x70, 0x00, 0x00, 0x00, 0xC4, 0x0E, 0x00, 0x00, 0xC4, 0x0E, 0x00, 0x00, 0x00, 0x00, 0x00, 0x00, 0x00, 0x00, 0x00, 0x00, 0x00, 0x00, 0x00, 0x00, 0x00, 0x00, 0x80, 0x00, 0x00, 0x80,
 0x00, 0x00, 0x00, 0x80, 0x80, 0x00, 0x80, 0x00, 0x00, 0x00, 0x80, 0x00, 0x80, 0x00, 0x80, 0x80, 0x00, 0x00, 0x80, 0x80, 0x80, 0x00, 0xC0, 0xC0, 0xC0, 0x00, 0x00, 0x00, 0xFF, 0x00, 0x00, 0xFF,
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 0x00, 0x00, 0x00, 0x00, 0x00, 0x00, 0xFF,

};

//A Vertical solid line 46px height * 2px width
const unsigned char verticalLine[] ={
 0x42, 0x4D, 0x2E, 0x01, 0x00, 0x00, 0x00, 0x00, 0x00, 0x00, 0x76, 0x00, 0x00, 0x00, 0x28, 0x00, 0x00, 0x00, 0x02, 0x00, 0x00, 0x00, 0x2E, 0x00, 0x00, 0x00, 0x01, 0x00, 0x04, 0x00, 0x00, 0x00,
 0x00, 0x00, 0xB8, 0x00, 0x00, 0x00, 0xC4, 0x0E, 0x00, 0x00, 0xC4, 0x0E, 0x00, 0x00, 0x00, 0x00, 0x00, 0x00, 0x00, 0x00, 0x00, 0x00, 0x00, 0x00, 0x00, 0x00, 0x00, 0x00, 0x80, 0x00, 0x00, 0x80,
 0x00, 0x00, 0x00, 0x80, 0x80, 0x00, 0x80, 0x00, 0x00, 0x00, 0x80, 0x00, 0x80, 0x00, 0x80, 0x80, 0x00, 0x00, 0x80, 0x80, 0x80, 0x00, 0xC0, 0xC0, 0xC0, 0x00, 0x00, 0x00, 0xFF, 0x00, 0x00, 0xFF,
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 0x00, 0x00, 0xFF, 0x00, 0x00, 0x00, 0xFF, 0x00, 0x00, 0x00, 0xFF, 0x00, 0x00, 0x00, 0xFF,

};

// intro background 48px height * 84px width
const unsigned char introbg[] ={
 0x42, 0x4D, 0xB6, 0x08, 0x00, 0x00, 0x00, 0x00, 0x00, 0x00, 0x76, 0x00, 0x00, 0x00, 0x28, 0x00, 0x00, 0x00, 0x54, 0x00, 0x00, 0x00, 0x30, 0x00, 0x00, 0x00, 0x01, 0x00, 0x04, 0x00, 0x00, 0x00,
 0x00, 0x00, 0x40, 0x08, 0x00, 0x00, 0xC4, 0x0E, 0x00, 0x00, 0xC4, 0x0E, 0x00, 0x00, 0x00, 0x00, 0x00, 0x00, 0x00, 0x00, 0x00, 0x00, 0x00, 0x00, 0x00, 0x00, 0x00, 0x00, 0x80, 0x00, 0x00, 0x80,
 0x00, 0x00, 0x00, 0x80, 0x80, 0x00, 0x80, 0x00, 0x00, 0x00, 0x80, 0x00, 0x80, 0x00, 0x80, 0x80, 0x00, 0x00, 0x80, 0x80, 0x80, 0x00, 0xC0, 0xC0, 0xC0, 0x00, 0x00, 0x00, 0xFF, 0x00, 0x00, 0xFF,
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 0xFF, 0xFF, 0xFF, 0xFF, 0xFF, 0xFF, 0xFF, 0xFF, 0xFF, 0xFF, 0xFF, 0xFF, 0xFF, 0xFF, 0xFF, 0xFF, 0xFF, 0xFF, 0xFF, 0xFF, 0x00, 0x00, 0xFF,

};


#define SQUAREHEIGHT     ((unsigned char)square[22])
#define VH               ((unsigned char)verticalLine[22])
int playedCells;
char turnMark;
int  currentCell;
char matrix[9];
int  xWins=0, oWins=0;
int main(void)
{
	TExaS_Init(SSI0_Real_Nokia5110_Scope);  // set system clock to 80 MHz
	PortF_Init();
	Nokia5110_Init();
	Nokia5110_DisplayBuffer();      // draw buffer
	
	Intro();
	resetGameSettings();
	ClearGameMatrix();
	while(1)
	{
		play();
	}

}

void Intro(void){
	Nokia5110_PrintBMP(0, 47, introbg, 0);
	Nokia5110_DisplayBuffer();
	Nokia5110_SetCursor(1, 3);
	Nokia5110_OutString("Welcome to");
	Nokia5110_SetCursor(1, 4);
	Nokia5110_OutString(" X-O Game");
	Delay100ms(10);    
	Nokia5110_DisplayBuffer();
	Nokia5110_SetCursor(2, 3);
	Nokia5110_OutString("X-Player");
	Nokia5110_SetCursor(1, 4);
	Nokia5110_OutString("playsFirst");
	Delay100ms(10);
	Nokia5110_Clear();
	//Nokia5110_OutUDec(1234);
}

void ClearGameMatrix(){
	Nokia5110_ClearBuffer();
	Nokia5110_PrintBMP(0, (SQUAREHEIGHT-1), square, 0);
	Nokia5110_PrintBMP(0, 2*(SQUAREHEIGHT-1)+3, square, 0);
	Nokia5110_PrintBMP(0, 3*(SQUAREHEIGHT-1)+6, square, 0);
	
	Nokia5110_PrintBMP((SQUAREHEIGHT-1) +3, (SQUAREHEIGHT-1), square, 0);
	Nokia5110_PrintBMP((SQUAREHEIGHT-1) +3, 2*(SQUAREHEIGHT-1)+3, square, 0);
	Nokia5110_PrintBMP((SQUAREHEIGHT-1) +3, 3*(SQUAREHEIGHT-1)+6, square, 0);
	
	Nokia5110_PrintBMP(2*(SQUAREHEIGHT-1) +6, (SQUAREHEIGHT-1), square, 0);
	Nokia5110_PrintBMP(2*(SQUAREHEIGHT-1) +6, 2*(SQUAREHEIGHT-1)+3, square, 0);
	Nokia5110_PrintBMP(2*(SQUAREHEIGHT-1) +6, 3*(SQUAREHEIGHT-1)+6, square, 0);
	Nokia5110_PrintBMP(3*(SQUAREHEIGHT-1) +9, (VH-1), verticalLine, 0);
	Nokia5110_DisplayBuffer();
	displayStatus();
}

void play(){
	int row, col, lastRow, lastCol, lastCell;
	int  f1=0,f2=0;
	while(!(GPIO_PORTF_DATA_R&0x10))f1=1;      // read PF4 and wait untill release
	while(!(GPIO_PORTF_DATA_R&0x01))f2=1;      // read PF0 and wait untill release
	if(f2 && currentCell!=-1){           
		if(matrix[currentCell]==' '){
			row = currentCell/3;
			col = currentCell%3;
			if(turnMark=='X'){
				Nokia5110_PrintBMP(col*(SQUAREHEIGHT-1)+ 3*col, (row+1)*(SQUAREHEIGHT-1)+3*row, X, 0);
				matrix[currentCell]=turnMark;
				if(checkWinner(turnMark)){
					displayWinner(turnMark);
					if(checkReplay()){
						resetGameSettings();
						ClearGameMatrix();
						return;
					}
					else{
						outro();
						while(1);
					}
				}
				turnMark='O';
			}
			else{
				Nokia5110_PrintBMP(col*(SQUAREHEIGHT-1)+ 3*col, (row+1)*(SQUAREHEIGHT-1)+3*row, O, 0);
				matrix[currentCell]=turnMark;
				if(checkWinner(turnMark)){
					displayWinner(turnMark);
					if(checkReplay()){
						resetGameSettings();
						ClearGameMatrix();
						return;
					}
					else{
						outro();
						while(1);
					}
				}
				turnMark='X';
			}
			Nokia5110_DisplayBuffer();
			displayStatus();
			currentCell=-1;
			playedCells++;
			if(playedCells==9){
				displayDraw();
				if(checkReplay()){
						resetGameSettings();
						ClearGameMatrix();
						return;
				}
				else{
					outro();
					while(1);
				}
			}
		}
		else{
			GPIO_PORTF_DATA_R = 0x02;     // LED is red
			Nokia5110_SetCursor(7, 3);
			Nokia5110_OutString("Can't");
			Nokia5110_SetCursor(7, 4);
			Nokia5110_OutString("play");
			Nokia5110_SetCursor(7, 5);
			Nokia5110_OutString("here!");
			Delay100ms(10);
			GPIO_PORTF_DATA_R = 0x00;     // LED is dark
			Nokia5110_DisplayBuffer();
			displayStatus();
		}
	}
	if(f1){
		lastCell=currentCell;
		currentCell++;
		if(currentCell==9)currentCell=0;
		row = currentCell/3;
		col = currentCell%3;
		if(matrix[currentCell]=='X'){
			Nokia5110_PrintBMP(col*(SQUAREHEIGHT-1)+ 3*col, (row+1)*(SQUAREHEIGHT-1)+3*row, selectedX, 0);
		}
		else if(matrix[currentCell]=='O'){
			Nokia5110_PrintBMP(col*(SQUAREHEIGHT-1)+ 3*col, (row+1)*(SQUAREHEIGHT-1)+3*row, selectedO, 0);
		}
		else{
			Nokia5110_PrintBMP(col*(SQUAREHEIGHT-1)+ 3*col, (row+1)*(SQUAREHEIGHT-1)+3*row, selectedSquare, 0);
		}
		if(lastCell==8||lastCell==-1){
			lastRow = 2;
	  	lastCol = 2;
			lastCell=8;
		}
		else{
			lastRow = (currentCell-1)/3;
		  lastCol = (currentCell-1)%3;
		}
		
		if(matrix[lastCell]=='X'){
			Nokia5110_PrintBMP(lastCol*(SQUAREHEIGHT-1)+ 3*lastCol, (lastRow+1)*(SQUAREHEIGHT-1)+3*lastRow, X, 0);
		}
		else if(matrix[lastCell]=='O'){
			Nokia5110_PrintBMP(lastCol*(SQUAREHEIGHT-1)+ 3*lastCol, (lastRow+1)*(SQUAREHEIGHT-1)+3*lastRow, O, 0);
		}
		else{
			Nokia5110_PrintBMP(lastCol*(SQUAREHEIGHT-1)+ 3*lastCol, (lastRow+1)*(SQUAREHEIGHT-1)+3*lastRow, square, 0);
		}
		Nokia5110_DisplayBuffer();
		displayStatus();
	}
}

int checkWinner(char player){
	int c1=0,c2=0,c3=0, i;
	if(matrix[0]==player && matrix[1]==player && matrix[2]==player){
		c1=0; c2=1; c3=2; i=0;
	}
	else if(matrix[3]==player && matrix[4]==player && matrix[5]==player){
		c1=3; c2=4; c3=5; i=1;
	}
	else if(matrix[6]==player && matrix[7]==player && matrix[8]==player){
		c1=6; c2=7; c3=8; i=2;
	}
	else if(matrix[0]==player && matrix[3]==player && matrix[6]==player){
		c1=0; c2=3; c3=6; i=3;
	}
	else if(matrix[1]==player && matrix[4]==player && matrix[7]==player){
		c1=1; c2=4; c3=7; i=4;
	}
	else if(matrix[2]==player && matrix[5]==player && matrix[8]==player){
		c1=2; c2=5; c3=8; i=5;
	}
	else if(matrix[0]==player && matrix[4]==player && matrix[8]==player){
		c1=0; c2=4; c3=8; i=6;
	}
	else if(matrix[2]==player && matrix[4]==player && matrix[6]==player){
		c1=2; c2=4; c3=6; i=7;
	}
	if(c1||c2||c3){
		if(player=='X'){
			Nokia5110_PrintBMP((c1%3)*(SQUAREHEIGHT-1)+ 3*(c1%3), (c1/3+1)*(SQUAREHEIGHT-1)+3*(c1/3), selectedX, 0);
			Nokia5110_PrintBMP((c2%3)*(SQUAREHEIGHT-1)+ 3*(c2%3), (c2/3+1)*(SQUAREHEIGHT-1)+3*(c2/3), selectedX, 0);
			Nokia5110_PrintBMP((c3%3)*(SQUAREHEIGHT-1)+ 3*(c3%3), (c3/3+1)*(SQUAREHEIGHT-1)+3*(c3/3), selectedX, 0);
			GPIO_PORTF_DATA_R = 0x04;       // LED is blue
		}
		else {
			Nokia5110_PrintBMP((c1%3)*(SQUAREHEIGHT-1)+ 3*(c1%3), (c1/3+1)*(SQUAREHEIGHT-1)+3*(c1/3), selectedO, 0);
			Nokia5110_PrintBMP((c2%3)*(SQUAREHEIGHT-1)+ 3*(c2%3), (c2/3+1)*(SQUAREHEIGHT-1)+3*(c2/3), selectedO, 0);
			Nokia5110_PrintBMP((c3%3)*(SQUAREHEIGHT-1)+ 3*(c3%3), (c3/3+1)*(SQUAREHEIGHT-1)+3*(c3/3), selectedO, 0);
			GPIO_PORTF_DATA_R = 0x08;      // LED is green
		}
		//line strike
		if(i==0){
			for(i=0;i<48;i++)Nokia5110_SetPixel(i,6);
		}
		else if(i==1){
			for(i=0;i<48;i++)Nokia5110_SetPixel(i,23);
		}
		else if(i==2){
			for(i=0;i<48;i++)Nokia5110_SetPixel(i,40);
		}
		else if(i==3){
			for(i=0;i<48;i++)Nokia5110_SetPixel(6,i);
		}
		else if(i==4){
			for(i=0;i<48;i++)Nokia5110_SetPixel(23,i);
		}
		else if(i==5){
			for(i=0;i<48;i++)Nokia5110_SetPixel(40,i);
		}
		else if(i==6){
			for(i=0;i<48;i++)Nokia5110_SetPixel(i,i);
		}
		else if(i==7){
			for(i=0;i<48;i++)Nokia5110_SetPixel(i,47-i);
		}
		Nokia5110_DisplayBuffer();
		Delay100ms(10);
		GPIO_PORTF_DATA_R = 0x00;     // LED is dark
		return 1;
	}
	return 0;
}


void displayWinner(char player){
	(player=='X')?xWins++:oWins++;
	Nokia5110_ClearBuffer();
	Nokia5110_PrintBMP(0, 47, introbg, 0);
	Nokia5110_DisplayBuffer();
	Nokia5110_SetCursor(2, 3);
	Nokia5110_OutChar(player);
	Nokia5110_OutString("-Player");
	Nokia5110_SetCursor(4, 4);
	Nokia5110_OutString("wins");
	Delay100ms(10);
	Nokia5110_DisplayBuffer();
	Nokia5110_SetCursor(1, 3);
	Nokia5110_OutString("X:");
	Nokia5110_OutUDec(xWins);
	Nokia5110_SetCursor(1, 4);
	Nokia5110_OutString("O:");
	Nokia5110_OutUDec(oWins);
	Delay100ms(10);
	Nokia5110_Clear();
}

void displayDraw(){
	GPIO_PORTF_DATA_R = 0x0E;     // LED is white
	Delay100ms(10);
	GPIO_PORTF_DATA_R = 0x00;     // LED is dark
	Nokia5110_ClearBuffer();
	Nokia5110_PrintBMP(0, 47, introbg, 0);
	Nokia5110_DisplayBuffer();
	Nokia5110_SetCursor(2, 3);
	Nokia5110_OutString("Game is");
	Nokia5110_SetCursor(2, 4);
	Nokia5110_OutString("a draw");
	Delay100ms(10);
	Nokia5110_Clear();
}

void displayStatus(){
	Nokia5110_SetCursor(8, 1);
	Nokia5110_OutChar('<');
	Nokia5110_OutChar(turnMark);
	Nokia5110_OutChar('>');
	Nokia5110_SetCursor(8, 2);
	Nokia5110_OutString("Turn");
	
}

int checkReplay(){
	Nokia5110_ClearBuffer();
	Nokia5110_PrintBMP(0, 47, introbg, 0);
	Nokia5110_DisplayBuffer();
	Nokia5110_SetCursor(0, 3);
	Nokia5110_OutString("Play again ?");
	Nokia5110_SetCursor(1, 4);
	Nokia5110_OutString("SW1: |SW2:");
	Nokia5110_SetCursor(1, 5);
	Nokia5110_OutString("Yes  |  No");
	while(1){
		int  f1=0,f2=0;
		while(!(GPIO_PORTF_DATA_R&0x10))f1=1;      // read PF4 and wait untill release
		if(f1)return 1;
		while(!(GPIO_PORTF_DATA_R&0x01))f2=1;      // read PF0 and wait untill release
		if(f2)return 0;
	}
}

void resetGameSettings(){
	int i;
	playedCells=0;
	turnMark='X';
	currentCell=-1;
	for(i=0;i<9;i++)matrix[i]=' ';
}

void outro(){
	Nokia5110_ClearBuffer();
	Nokia5110_PrintBMP(0, 47, introbg, 0);
	Nokia5110_DisplayBuffer();
	Nokia5110_SetCursor(1, 3);
	Nokia5110_OutString("Game Over");
	Delay100ms(10);
	Nokia5110_Clear();
}

// You can use this timer only if you learn how it works
void Timer2_Init(unsigned long period)
{
	unsigned long volatile delay;
	SYSCTL_RCGCTIMER_R |= 0x04;   // 0) activate timer2
	delay = SYSCTL_RCGCTIMER_R;
	TimerCount = 0;
	Semaphore = 0;
	TIMER2_CTL_R = 0x00000000;    // 1) disable timer2A during setup
	TIMER2_CFG_R = 0x00000000;    // 2) configure for 32-bit mode
	TIMER2_TAMR_R = 0x00000002;   // 3) configure for periodic mode, default down-count settings
	TIMER2_TAILR_R = period-1;    // 4) reload value
	TIMER2_TAPR_R = 0;            // 5) bus clock resolution
	TIMER2_ICR_R = 0x00000001;    // 6) clear timer2A timeout flag
	TIMER2_IMR_R = 0x00000001;    // 7) arm timeout interrupt
	NVIC_PRI5_R = (NVIC_PRI5_R&0x00FFFFFF)|0x80000000; // 8) priority 4
// interrupts enabled in the main program after all devices initialized
// vector number 39, interrupt number 23
	NVIC_EN0_R = 1<<23;           // 9) enable IRQ 23 in NVIC
	TIMER2_CTL_R = 0x00000001;    // 10) enable timer2A
}

void PortF_Init(void){ volatile unsigned long delay;
  SYSCTL_RCGC2_R |= 0x00000020;     // 1) F clock
  delay = SYSCTL_RCGC2_R;           // delay
  GPIO_PORTF_LOCK_R = 0x4C4F434B;   // 2) unlock PortF PF0
  GPIO_PORTF_CR_R = 0x1F;           // allow changes to PF4-0
  GPIO_PORTF_AMSEL_R = 0x00;        // 3) disable analog function
  GPIO_PORTF_PCTL_R = 0x00000000;   // 4) GPIO clear bit PCTL
  GPIO_PORTF_DIR_R = 0x0E;          // 5) PF4,PF0 input, PF3,PF2,PF1 output
  GPIO_PORTF_AFSEL_R = 0x00;        // 6) no alternate function
  GPIO_PORTF_PUR_R = 0x11;          // enable pullup resistors on PF4,PF0
  GPIO_PORTF_DEN_R = 0x1F;          // 7) enable digital pins PF4-PF0
}

void Timer2A_Handler(void)
{
	TIMER2_ICR_R = 0x00000001;   // acknowledge timer2A timeout
	TimerCount++;
	Semaphore = 1; // trigger
}
void Delay100ms(unsigned long count)
{
	unsigned long volatile time;
	while(count>0)
	{
		time = 727240;  // 0.1sec at 80 MHz
		while(time)
		{
			time--;
		}
		count--;
	}
}
